## templates/vanilla/west.yml
```yaml
manifest:
  remotes:
    - name: zephyrproject
      url-base: https://github.com/zephyrproject-rtos
  projects:
    - name: zephyr
      repo-path: zephyr
      remote: zephyrproject
      revision: v3.6.0
      import:
        path-prefix: external
  self:
    # This repository should be cloned to 
    path: app
```
